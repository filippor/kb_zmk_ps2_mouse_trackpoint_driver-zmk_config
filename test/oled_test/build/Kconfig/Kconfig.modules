## test/oled_test/build/Kconfig/Kconfig.modules
```kconfig
config ZEPHYR_HAL_STM32_MODULE
	bool
	default y

config ZEPHYR_HAL_STM32_MODULE_BLOBS
	bool
menu "lvgl (/workspaces/zmk/modules/lib/gui/lvgl)"
osource "/workspaces/zmk/modules/lib/gui/lvgl/zephyr/Kconfig"
config ZEPHYR_LVGL_MODULE
	bool
	default y
endmenu
config ZEPHYR_ZMK_STUDIO_MESSAGES_MODULE
	bool
	default y
menu "canopennode (/workspaces/zmk/modules/lib/canopennode)"
osource "$(ZEPHYR_CANOPENNODE_KCONFIG)"
config ZEPHYR_CANOPENNODE_MODULE
	bool
	default y
endmenu
menu "chre (/workspaces/zmk/modules/lib/chre)"
osource "/workspaces/zmk/modules/lib/chre/platform/zephyr/Kconfig"
config ZEPHYR_CHRE_MODULE
	bool
	default y
endmenu
menu "lz4 (/workspaces/zmk/modules/lib/lz4)"
osource "$(ZEPHYR_LZ4_KCONFIG)"
config ZEPHYR_LZ4_MODULE
	bool
	default y
endmenu
menu "nanopb (/workspaces/zmk/modules/lib/nanopb)"
osource "$(ZEPHYR_NANOPB_KCONFIG)"
config ZEPHYR_NANOPB_MODULE
	bool
	default y
endmenu
config ZEPHYR_PSA_ARCH_TESTS_MODULE
	bool
	default y
menu "sof (/workspaces/zmk/modules/audio/sof)"
osource "/workspaces/zmk/modules/audio/sof/zephyr/Kconfig"
config ZEPHYR_SOF_MODULE
	bool
	default y
endmenu
config ZEPHYR_TF_M_TESTS_MODULE
	bool
	default y
menu "tflite-micro (/workspaces/zmk/optional/modules/lib/tflite-micro)"
osource "$(ZEPHYR_TFLITE_MICRO_KCONFIG)"
config ZEPHYR_TFLITE_MICRO_MODULE
	bool
	default y
endmenu
menu "thrift (/workspaces/zmk/optional/modules/lib/thrift)"
osource "$(ZEPHYR_THRIFT_KCONFIG)"
config ZEPHYR_THRIFT_MODULE
	bool
	default y
endmenu
menu "lang-rust (/workspaces/zmk/modules/lang/rust)"
osource "/workspaces/zmk/modules/lang/rust/Kconfig"
config ZEPHYR_LANG_RUST_MODULE
	bool
	default y
endmenu
menu "zscilib (/workspaces/zmk/modules/lib/zscilib)"
osource "/workspaces/zmk/modules/lib/zscilib/Kconfig.zscilib"
config ZEPHYR_ZSCILIB_MODULE
	bool
	default y
endmenu
menu "acpica (/workspaces/zmk/modules/lib/acpica)"
osource "$(ZEPHYR_ACPICA_KCONFIG)"
config ZEPHYR_ACPICA_MODULE
	bool
	default y
endmenu
menu "cmsis (/workspaces/zmk/modules/hal/cmsis)"
osource "$(ZEPHYR_CMSIS_KCONFIG)"
config ZEPHYR_CMSIS_MODULE
	bool
	default y
endmenu
menu "cmsis-dsp (/workspaces/zmk/modules/lib/cmsis-dsp)"
osource "$(ZEPHYR_CMSIS_DSP_KCONFIG)"
config ZEPHYR_CMSIS_DSP_MODULE
	bool
	default y
endmenu
menu "cmsis-nn (/workspaces/zmk/modules/lib/cmsis-nn)"
osource "$(ZEPHYR_CMSIS_NN_KCONFIG)"
config ZEPHYR_CMSIS_NN_MODULE
	bool
	default y
endmenu
menu "fatfs (/workspaces/zmk/modules/fs/fatfs)"
osource "$(ZEPHYR_FATFS_KCONFIG)"
config ZEPHYR_FATFS_MODULE
	bool
	default y
endmenu
config ZEPHYR_ADI_MODULE
	bool
	default y
menu "hal_ambiq (/workspaces/zmk/modules/hal/ambiq)"
osource "$(ZEPHYR_HAL_AMBIQ_KCONFIG)"
config ZEPHYR_HAL_AMBIQ_MODULE
	bool
	default y
endmenu
config ZEPHYR_ATMEL_MODULE
	bool
	default y
menu "hal_espressif (/workspaces/zmk/modules/hal/espressif)"
osource "/workspaces/zmk/modules/hal/espressif/zephyr/Kconfig"
config ZEPHYR_HAL_ESPRESSIF_MODULE
	bool
	default y

config ZEPHYR_HAL_ESPRESSIF_MODULE_BLOBS
	bool
endmenu
menu "hal_ethos_u (/workspaces/zmk/modules/hal/ethos_u)"
osource "$(ZEPHYR_HAL_ETHOS_U_KCONFIG)"
config ZEPHYR_HAL_ETHOS_U_MODULE
	bool
	default y
endmenu
menu "hal_gigadevice (/workspaces/zmk/modules/hal/gigadevice)"
osource "$(ZEPHYR_HAL_GIGADEVICE_KCONFIG)"
config ZEPHYR_HAL_GIGADEVICE_MODULE
	bool
	default y
endmenu
menu "hal_intel (/workspaces/zmk/modules/hal/intel)"
osource "/workspaces/zmk/modules/hal/intel/zephyr/Kconfig"
config ZEPHYR_HAL_INTEL_MODULE
	bool
	default y
endmenu
menu "hal_nordic (/workspaces/zmk/modules/hal/nordic)"
osource "$(ZEPHYR_HAL_NORDIC_KCONFIG)"
config ZEPHYR_HAL_NORDIC_MODULE
	bool
	default y

config ZEPHYR_HAL_NORDIC_MODULE_BLOBS
	bool
endmenu
config ZEPHYR_NUVOTON_MODULE
	bool
	default y
config ZEPHYR_QUICKLOGIC_MODULE
	bool
	default y
config ZEPHYR_HAL_RENESAS_MODULE
	bool
	default y

config ZEPHYR_HAL_RENESAS_MODULE_BLOBS
	bool
menu "hal_rpi_pico (/workspaces/zmk/modules/hal/rpi_pico)"
osource "$(ZEPHYR_HAL_RPI_PICO_KCONFIG)"
config ZEPHYR_HAL_RPI_PICO_MODULE
	bool
	default y
endmenu
menu "hal_silabs (/workspaces/zmk/modules/hal/silabs)"
osource "$(ZEPHYR_HAL_SILABS_KCONFIG)"
config ZEPHYR_HAL_SILABS_MODULE
	bool
	default y

config ZEPHYR_HAL_SILABS_MODULE_BLOBS
	bool
endmenu
menu "hal_tdk (/workspaces/zmk/modules/hal/tdk)"
osource "$(ZEPHYR_HAL_TDK_KCONFIG)"
config ZEPHYR_HAL_TDK_MODULE
	bool
	default y
endmenu
menu "hal_telink (/workspaces/zmk/modules/hal/telink)"
osource "/workspaces/zmk/modules/hal/telink/Kconfig"
config ZEPHYR_HAL_TELINK_MODULE
	bool
	default y
endmenu
menu "hal_wch (/workspaces/zmk/modules/hal/wch)"
osource "$(ZEPHYR_HAL_WCH_KCONFIG)"
config ZEPHYR_HAL_WCH_MODULE
	bool
	default y
endmenu
config ZEPHYR_HAL_WURTHELEKTRONIK_MODULE
	bool
	default y
menu "hostap (/workspaces/zmk/modules/lib/hostap)"
osource "$(ZEPHYR_HOSTAP_KCONFIG)"
config ZEPHYR_HOSTAP_MODULE
	bool
	default y
endmenu
menu "liblc3 (/workspaces/zmk/modules/lib/liblc3)"
osource "$(ZEPHYR_LIBLC3_KCONFIG)"
config ZEPHYR_LIBLC3_MODULE
	bool
	default y
endmenu
config ZEPHYR_LIBMCTP_MODULE
	bool
	default y
config ZEPHYR_LIBMETAL_MODULE
	bool
	default y
menu "littlefs (/workspaces/zmk/modules/fs/littlefs)"
osource "$(ZEPHYR_LITTLEFS_KCONFIG)"
config ZEPHYR_LITTLEFS_MODULE
	bool
	default y
endmenu
menu "mbedtls (/workspaces/zmk/modules/crypto/mbedtls)"
osource "$(ZEPHYR_MBEDTLS_KCONFIG)"
config ZEPHYR_MBEDTLS_MODULE
	bool
	default y
endmenu
config ZEPHYR_MIPI_SYS_T_MODULE
	bool
	default y
menu "nrf_wifi (/workspaces/zmk/modules/lib/nrf_wifi)"
osource "$(ZEPHYR_NRF_WIFI_KCONFIG)"
config ZEPHYR_NRF_WIFI_MODULE
	bool
	default y

config ZEPHYR_NRF_WIFI_MODULE_BLOBS
	bool
endmenu
config ZEPHYR_OPEN_AMP_MODULE
	bool
	default y
menu "percepio (/workspaces/zmk/modules/debug/percepio)"
osource "/workspaces/zmk/modules/debug/percepio/zephyr/Kconfig"
config ZEPHYR_PERCEPIO_MODULE
	bool
	default y
endmenu
menu "picolibc (/workspaces/zmk/modules/lib/picolibc)"
osource "/workspaces/zmk/modules/lib/picolibc/zephyr/Kconfig"
config ZEPHYR_PICOLIBC_MODULE
	bool
	default y
endmenu
menu "segger (/workspaces/zmk/modules/debug/segger)"
osource "$(ZEPHYR_SEGGER_KCONFIG)"
config ZEPHYR_SEGGER_MODULE
	bool
	default y
endmenu
config ZEPHYR_TINYCRYPT_MODULE
	bool
	default y
menu "trusted-firmware-a (/workspaces/zmk/modules/tee/tf-a/trusted-firmware-a)"
osource "$(ZEPHYR_TRUSTED_FIRMWARE_A_KCONFIG)"
config ZEPHYR_TRUSTED_FIRMWARE_A_MODULE
	bool
	default y
endmenu
menu "uoscore-uedhoc (/workspaces/zmk/modules/lib/uoscore-uedhoc)"
osource "$(ZEPHYR_UOSCORE_UEDHOC_KCONFIG)"
config ZEPHYR_UOSCORE_UEDHOC_MODULE
	bool
	default y
endmenu
menu "zcbor (/workspaces/zmk/modules/lib/zcbor)"
osource "$(ZEPHYR_ZCBOR_KCONFIG)"
config ZEPHYR_ZCBOR_MODULE
	bool
	default y
endmenu
config ZEPHYR_NRF_HW_MODELS_MODULE
	bool
	default y
```

## test/oled_test/build/Kconfig/arch/Kconfig
```kconfig
# Load Zephyr Arch Kconfig descriptions.
osource "/workspaces/zmk/zephyr/arch/x86/Kconfig"
osource "/workspaces/zmk/zephyr/arch/xtensa/Kconfig"
osource "/workspaces/zmk/zephyr/arch/sparc/Kconfig"
osource "/workspaces/zmk/zephyr/arch/riscv/Kconfig"
osource "/workspaces/zmk/zephyr/arch/posix/Kconfig"
osource "/workspaces/zmk/zephyr/arch/nios2/Kconfig"
osource "/workspaces/zmk/zephyr/arch/mips/Kconfig"
osource "/workspaces/zmk/zephyr/arch/arm64/Kconfig"
osource "/workspaces/zmk/zephyr/arch/arm/Kconfig"
osource "/workspaces/zmk/zephyr/arch/arc/Kconfig"
```

## test/oled_test/build/Kconfig/boards/Kconfig
```kconfig
# Load Zephyr board Kconfig descriptions.
osource "/workspaces/zmk/app/module/boards/nicekeyboards/nice_nano/Kconfig"
```

## test/oled_test/build/Kconfig/boards/Kconfig.defconfig
```kconfig
# Load Zephyr board defconfig descriptions.
osource "/workspaces/zmk/app/module/boards/nicekeyboards/nice_nano/Kconfig.defconfig"
```

## test/oled_test/build/Kconfig/boards/Kconfig.nice_nano
```kconfig
# Load board Kconfig descriptions.
osource "/workspaces/zmk/app/module/boards/nicekeyboards/nice_nano/Kconfig.nice_nano"
```

## test/oled_test/build/Kconfig/boards/Kconfig.sysbuild
```kconfig
# Load Sysbuild board Kconfig descriptions.
osource "/workspaces/zmk/app/module/boards/nicekeyboards/nice_nano/Kconfig.sysbuild"
```

## test/oled_test/build/Kconfig/soc/Kconfig
```kconfig
# Load Zephyr SoC Kconfig descriptions.
osource "/workspaces/zmk/zephyr/soc/xlnx/zynqmp/Kconfig"
osource "/workspaces/zmk/zephyr/soc/xlnx/zynq7000/Kconfig"
osource "/workspaces/zmk/zephyr/soc/xen/Kconfig"
osource "/workspaces/zmk/zephyr/soc/wch/ch32v/Kconfig"
osource "/workspaces/zmk/zephyr/soc/ti/simplelink/Kconfig"
osource "/workspaces/zmk/zephyr/soc/ti/lm3s6965/Kconfig"
osource "/workspaces/zmk/zephyr/soc/ti/k3/Kconfig"
osource "/workspaces/zmk/zephyr/soc/telink/tlsr/Kconfig"
osource "/workspaces/zmk/zephyr/soc/starfive/jh71xx/Kconfig"
osource "/workspaces/zmk/zephyr/soc/st/stm32/Kconfig"
osource "/workspaces/zmk/zephyr/soc/snps/qemu_arc/Kconfig"
osource "/workspaces/zmk/zephyr/soc/snps/nsim/arc_v/Kconfig"
osource "/workspaces/zmk/zephyr/soc/snps/nsim/arc_classic/Kconfig"
osource "/workspaces/zmk/zephyr/soc/snps/hsdk4xd/Kconfig"
osource "/workspaces/zmk/zephyr/soc/snps/hsdk/Kconfig"
osource "/workspaces/zmk/zephyr/soc/snps/emsk/Kconfig"
osource "/workspaces/zmk/zephyr/soc/snps/emsdp/Kconfig"
osource "/workspaces/zmk/zephyr/soc/snps/arc_iot/Kconfig"
osource "/workspaces/zmk/zephyr/soc/silabs/Kconfig"
osource "/workspaces/zmk/zephyr/soc/sifive/sifive_freedom/Kconfig"
osource "/workspaces/zmk/zephyr/soc/sensry/Kconfig"
osource "/workspaces/zmk/zephyr/soc/rockchip/Kconfig"
osource "/workspaces/zmk/zephyr/soc/renode/riscv_virtual/Kconfig"
osource "/workspaces/zmk/zephyr/soc/renode/cortex_r8_virtual/Kconfig"
osource "/workspaces/zmk/zephyr/soc/renesas/smartbond/Kconfig"
osource "/workspaces/zmk/zephyr/soc/renesas/rzt2m/Kconfig"
osource "/workspaces/zmk/zephyr/soc/renesas/rz/Kconfig"
osource "/workspaces/zmk/zephyr/soc/renesas/rcar/Kconfig"
osource "/workspaces/zmk/zephyr/soc/renesas/ra/Kconfig"
osource "/workspaces/zmk/zephyr/soc/realtek/ec/Kconfig"
osource "/workspaces/zmk/zephyr/soc/raspberrypi/rpi_pico/Kconfig"
osource "/workspaces/zmk/zephyr/soc/quicklogic/eos_s3/Kconfig"
osource "/workspaces/zmk/zephyr/soc/qemu/virt_riscv/Kconfig"
osource "/workspaces/zmk/zephyr/soc/qemu/malta/Kconfig"
osource "/workspaces/zmk/zephyr/soc/openisa/rv32m1/Kconfig"
osource "/workspaces/zmk/zephyr/soc/nxp/s32/Kconfig"
osource "/workspaces/zmk/zephyr/soc/nxp/rw/Kconfig"
osource "/workspaces/zmk/zephyr/soc/nxp/mcx/Kconfig"
osource "/workspaces/zmk/zephyr/soc/nxp/lpc/Kconfig"
osource "/workspaces/zmk/zephyr/soc/nxp/layerscape/Kconfig"
osource "/workspaces/zmk/zephyr/soc/nxp/kinetis/Kconfig"
osource "/workspaces/zmk/zephyr/soc/nxp/imxrt/Kconfig"
osource "/workspaces/zmk/zephyr/soc/nxp/imx/Kconfig"
osource "/workspaces/zmk/zephyr/soc/nuvoton/numicro/Kconfig"
osource "/workspaces/zmk/zephyr/soc/nuvoton/numaker/Kconfig"
osource "/workspaces/zmk/zephyr/soc/nuvoton/npcx/Kconfig"
osource "/workspaces/zmk/zephyr/soc/nuvoton/npcm/Kconfig"
osource "/workspaces/zmk/zephyr/soc/nordic/Kconfig"
osource "/workspaces/zmk/zephyr/soc/neorv32/Kconfig"
osource "/workspaces/zmk/zephyr/soc/native/inf_clock/Kconfig"
osource "/workspaces/zmk/zephyr/soc/microchip/miv/Kconfig"
osource "/workspaces/zmk/zephyr/soc/microchip/mec/Kconfig"
osource "/workspaces/zmk/zephyr/soc/mediatek/mt8xxx/Kconfig"
osource "/workspaces/zmk/zephyr/soc/lowrisc/opentitan/Kconfig"
osource "/workspaces/zmk/zephyr/soc/litex/litex_vexriscv/Kconfig"
osource "/workspaces/zmk/zephyr/soc/ite/ec/Kconfig"
osource "/workspaces/zmk/zephyr/soc/intel/raptor_lake/Kconfig"
osource "/workspaces/zmk/zephyr/soc/intel/lakemont/Kconfig"
osource "/workspaces/zmk/zephyr/soc/intel/intel_socfpga_std/Kconfig"
osource "/workspaces/zmk/zephyr/soc/intel/intel_socfpga/Kconfig"
osource "/workspaces/zmk/zephyr/soc/intel/intel_niosv/Kconfig"
osource "/workspaces/zmk/zephyr/soc/intel/intel_ish/Kconfig"
osource "/workspaces/zmk/zephyr/soc/intel/intel_adsp/Kconfig"
osource "/workspaces/zmk/zephyr/soc/intel/elkhart_lake/Kconfig"
osource "/workspaces/zmk/zephyr/soc/intel/atom/Kconfig"
osource "/workspaces/zmk/zephyr/soc/intel/apollo_lake/Kconfig"
osource "/workspaces/zmk/zephyr/soc/intel/alder_lake/Kconfig"
osource "/workspaces/zmk/zephyr/soc/infineon/cat3/Kconfig"
osource "/workspaces/zmk/zephyr/soc/infineon/cat1b/Kconfig"
osource "/workspaces/zmk/zephyr/soc/infineon/cat1a/Kconfig"
osource "/workspaces/zmk/zephyr/soc/gd/gd32/Kconfig"
osource "/workspaces/zmk/zephyr/soc/gaisler/leon3/Kconfig"
osource "/workspaces/zmk/zephyr/soc/gaisler/gr716a/Kconfig"
osource "/workspaces/zmk/zephyr/soc/espressif/Kconfig"
osource "/workspaces/zmk/zephyr/soc/ene/kb1200/Kconfig"
osource "/workspaces/zmk/zephyr/soc/efinix/sapphire/Kconfig"
osource "/workspaces/zmk/zephyr/soc/cdns/xtensa_sample_controller/Kconfig"
osource "/workspaces/zmk/zephyr/soc/cdns/sample_controller32/Kconfig"
osource "/workspaces/zmk/zephyr/soc/cdns/dc233c/Kconfig"
osource "/workspaces/zmk/zephyr/soc/brcm/bcmvk/Kconfig"
osource "/workspaces/zmk/zephyr/soc/brcm/bcm2712/Kconfig"
osource "/workspaces/zmk/zephyr/soc/brcm/bcm2711/Kconfig"
osource "/workspaces/zmk/zephyr/soc/atmel/sam0/Kconfig"
osource "/workspaces/zmk/zephyr/soc/atmel/sam/Kconfig"
osource "/workspaces/zmk/zephyr/soc/aspeed/Kconfig"
osource "/workspaces/zmk/zephyr/soc/arm/Kconfig"
osource "/workspaces/zmk/zephyr/soc/arm/beetle/Kconfig"
osource "/workspaces/zmk/zephyr/soc/antmicro/myra/Kconfig"
osource "/workspaces/zmk/zephyr/soc/andestech/Kconfig"
osource "/workspaces/zmk/zephyr/soc/amd/acp_6_0/Kconfig"
osource "/workspaces/zmk/zephyr/soc/ambiq/Kconfig"
osource "/workspaces/zmk/zephyr/soc/altr/zephyr_nios2f/Kconfig"
osource "/workspaces/zmk/zephyr/soc/altr/qemu_nios2/Kconfig"
osource "/workspaces/zmk/zephyr/soc/adi/max32/Kconfig"
```
