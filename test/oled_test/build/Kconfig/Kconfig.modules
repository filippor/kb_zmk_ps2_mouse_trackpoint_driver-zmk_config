## test/oled_test/build/Kconfig/soc/Kconfig.soc
```kconfig
# Load SoC Kconfig descriptions.
osource "/workspaces/zmk/zephyr/soc/xlnx/zynqmp/Kconfig.soc"
osource "/workspaces/zmk/zephyr/soc/xlnx/zynq7000/Kconfig.soc"
osource "/workspaces/zmk/zephyr/soc/xen/Kconfig.soc"
osource "/workspaces/zmk/zephyr/soc/wch/ch32v/Kconfig.soc"
osource "/workspaces/zmk/zephyr/soc/ti/simplelink/Kconfig.soc"
osource "/workspaces/zmk/zephyr/soc/ti/lm3s6965/Kconfig.soc"
osource "/workspaces/zmk/zephyr/soc/ti/k3/Kconfig.soc"
osource "/workspaces/zmk/zephyr/soc/telink/tlsr/Kconfig.soc"
osource "/workspaces/zmk/zephyr/soc/starfive/jh71xx/Kconfig.soc"
osource "/workspaces/zmk/zephyr/soc/st/stm32/Kconfig.soc"
osource "/workspaces/zmk/zephyr/soc/snps/qemu_arc/Kconfig.soc"
osource "/workspaces/zmk/zephyr/soc/snps/nsim/arc_v/Kconfig.soc"
osource "/workspaces/zmk/zephyr/soc/snps/nsim/arc_classic/Kconfig.soc"
osource "/workspaces/zmk/zephyr/soc/snps/hsdk4xd/Kconfig.soc"
osource "/workspaces/zmk/zephyr/soc/snps/hsdk/Kconfig.soc"
osource "/workspaces/zmk/zephyr/soc/snps/emsk/Kconfig.soc"
osource "/workspaces/zmk/zephyr/soc/snps/emsdp/Kconfig.soc"
osource "/workspaces/zmk/zephyr/soc/snps/arc_iot/Kconfig.soc"
osource "/workspaces/zmk/zephyr/soc/silabs/Kconfig.soc"
osource "/workspaces/zmk/zephyr/soc/sifive/sifive_freedom/Kconfig.soc"
osource "/workspaces/zmk/zephyr/soc/sensry/Kconfig.soc"
osource "/workspaces/zmk/zephyr/soc/rockchip/Kconfig.soc"
osource "/workspaces/zmk/zephyr/soc/renode/riscv_virtual/Kconfig.soc"
osource "/workspaces/zmk/zephyr/soc/renode/cortex_r8_virtual/Kconfig.soc"
osource "/workspaces/zmk/zephyr/soc/renesas/smartbond/Kconfig.soc"
osource "/workspaces/zmk/zephyr/soc/renesas/rzt2m/Kconfig.soc"
osource "/workspaces/zmk/zephyr/soc/renesas/rz/Kconfig.soc"
osource "/workspaces/zmk/zephyr/soc/renesas/rcar/Kconfig.soc"
osource "/workspaces/zmk/zephyr/soc/renesas/ra/Kconfig.soc"
osource "/workspaces/zmk/zephyr/soc/realtek/ec/Kconfig.soc"
osource "/workspaces/zmk/zephyr/soc/raspberrypi/rpi_pico/Kconfig.soc"
osource "/workspaces/zmk/zephyr/soc/quicklogic/eos_s3/Kconfig.soc"
osource "/workspaces/zmk/zephyr/soc/qemu/virt_riscv/Kconfig.soc"
osource "/workspaces/zmk/zephyr/soc/qemu/malta/Kconfig.soc"
osource "/workspaces/zmk/zephyr/soc/openisa/rv32m1/Kconfig.soc"
osource "/workspaces/zmk/zephyr/soc/nxp/s32/Kconfig.soc"
osource "/workspaces/zmk/zephyr/soc/nxp/rw/Kconfig.soc"
osource "/workspaces/zmk/zephyr/soc/nxp/mcx/Kconfig.soc"
osource "/workspaces/zmk/zephyr/soc/nxp/lpc/Kconfig.soc"
osource "/workspaces/zmk/zephyr/soc/nxp/layerscape/Kconfig.soc"
osource "/workspaces/zmk/zephyr/soc/nxp/kinetis/Kconfig.soc"
osource "/workspaces/zmk/zephyr/soc/nxp/imxrt/Kconfig.soc"
osource "/workspaces/zmk/zephyr/soc/nxp/imx/Kconfig.soc"
osource "/workspaces/zmk/zephyr/soc/nuvoton/numicro/Kconfig.soc"
osource "/workspaces/zmk/zephyr/soc/nuvoton/numaker/Kconfig.soc"
osource "/workspaces/zmk/zephyr/soc/nuvoton/npcx/Kconfig.soc"
osource "/workspaces/zmk/zephyr/soc/nuvoton/npcm/Kconfig.soc"
osource "/workspaces/zmk/zephyr/soc/nordic/Kconfig.soc"
osource "/workspaces/zmk/zephyr/soc/neorv32/Kconfig.soc"
osource "/workspaces/zmk/zephyr/soc/native/inf_clock/Kconfig.soc"
osource "/workspaces/zmk/zephyr/soc/microchip/miv/Kconfig.soc"
osource "/workspaces/zmk/zephyr/soc/microchip/mec/Kconfig.soc"
osource "/workspaces/zmk/zephyr/soc/mediatek/mt8xxx/Kconfig.soc"
osource "/workspaces/zmk/zephyr/soc/lowrisc/opentitan/Kconfig.soc"
osource "/workspaces/zmk/zephyr/soc/litex/litex_vexriscv/Kconfig.soc"
osource "/workspaces/zmk/zephyr/soc/ite/ec/Kconfig.soc"
osource "/workspaces/zmk/zephyr/soc/intel/raptor_lake/Kconfig.soc"
osource "/workspaces/zmk/zephyr/soc/intel/lakemont/Kconfig.soc"
osource "/workspaces/zmk/zephyr/soc/intel/intel_socfpga_std/Kconfig.soc"
osource "/workspaces/zmk/zephyr/soc/intel/intel_socfpga/Kconfig.soc"
osource "/workspaces/zmk/zephyr/soc/intel/intel_niosv/Kconfig.soc"
osource "/workspaces/zmk/zephyr/soc/intel/intel_ish/Kconfig.soc"
osource "/workspaces/zmk/zephyr/soc/intel/intel_adsp/Kconfig.soc"
osource "/workspaces/zmk/zephyr/soc/intel/elkhart_lake/Kconfig.soc"
osource "/workspaces/zmk/zephyr/soc/intel/atom/Kconfig.soc"
osource "/workspaces/zmk/zephyr/soc/intel/apollo_lake/Kconfig.soc"
osource "/workspaces/zmk/zephyr/soc/intel/alder_lake/Kconfig.soc"
osource "/workspaces/zmk/zephyr/soc/infineon/cat3/Kconfig.soc"
osource "/workspaces/zmk/zephyr/soc/infineon/cat1b/Kconfig.soc"
osource "/workspaces/zmk/zephyr/soc/infineon/cat1a/Kconfig.soc"
osource "/workspaces/zmk/zephyr/soc/gd/gd32/Kconfig.soc"
osource "/workspaces/zmk/zephyr/soc/gaisler/leon3/Kconfig.soc"
osource "/workspaces/zmk/zephyr/soc/gaisler/gr716a/Kconfig.soc"
osource "/workspaces/zmk/zephyr/soc/espressif/Kconfig.soc"
osource "/workspaces/zmk/zephyr/soc/ene/kb1200/Kconfig.soc"
osource "/workspaces/zmk/zephyr/soc/efinix/sapphire/Kconfig.soc"
osource "/workspaces/zmk/zephyr/soc/cdns/xtensa_sample_controller/Kconfig.soc"
osource "/workspaces/zmk/zephyr/soc/cdns/sample_controller32/Kconfig.soc"
osource "/workspaces/zmk/zephyr/soc/cdns/dc233c/Kconfig.soc"
osource "/workspaces/zmk/zephyr/soc/brcm/bcmvk/Kconfig.soc"
osource "/workspaces/zmk/zephyr/soc/brcm/bcm2712/Kconfig.soc"
osource "/workspaces/zmk/zephyr/soc/brcm/bcm2711/Kconfig.soc"
osource "/workspaces/zmk/zephyr/soc/atmel/sam0/Kconfig.soc"
osource "/workspaces/zmk/zephyr/soc/atmel/sam/Kconfig.soc"
osource "/workspaces/zmk/zephyr/soc/aspeed/Kconfig.soc"
osource "/workspaces/zmk/zephyr/soc/arm/Kconfig.soc"
osource "/workspaces/zmk/zephyr/soc/arm/beetle/Kconfig.soc"
osource "/workspaces/zmk/zephyr/soc/antmicro/myra/Kconfig.soc"
osource "/workspaces/zmk/zephyr/soc/andestech/Kconfig.soc"
osource "/workspaces/zmk/zephyr/soc/amd/acp_6_0/Kconfig.soc"
osource "/workspaces/zmk/zephyr/soc/ambiq/Kconfig.soc"
osource "/workspaces/zmk/zephyr/soc/altr/zephyr_nios2f/Kconfig.soc"
osource "/workspaces/zmk/zephyr/soc/altr/qemu_nios2/Kconfig.soc"
osource "/workspaces/zmk/zephyr/soc/adi/max32/Kconfig.soc"
```

## test/oled_test/build/Kconfig/soc/Kconfig.sysbuild
```kconfig
# Load Sysbuild SoC Kconfig descriptions.
osource "/workspaces/zmk/zephyr/soc/xlnx/zynqmp/Kconfig.sysbuild"
osource "/workspaces/zmk/zephyr/soc/xlnx/zynq7000/Kconfig.sysbuild"
osource "/workspaces/zmk/zephyr/soc/xen/Kconfig.sysbuild"
osource "/workspaces/zmk/zephyr/soc/wch/ch32v/Kconfig.sysbuild"
osource "/workspaces/zmk/zephyr/soc/ti/simplelink/Kconfig.sysbuild"
osource "/workspaces/zmk/zephyr/soc/ti/lm3s6965/Kconfig.sysbuild"
osource "/workspaces/zmk/zephyr/soc/ti/k3/Kconfig.sysbuild"
osource "/workspaces/zmk/zephyr/soc/telink/tlsr/Kconfig.sysbuild"
osource "/workspaces/zmk/zephyr/soc/starfive/jh71xx/Kconfig.sysbuild"
osource "/workspaces/zmk/zephyr/soc/st/stm32/Kconfig.sysbuild"
osource "/workspaces/zmk/zephyr/soc/snps/qemu_arc/Kconfig.sysbuild"
osource "/workspaces/zmk/zephyr/soc/snps/nsim/arc_v/Kconfig.sysbuild"
osource "/workspaces/zmk/zephyr/soc/snps/nsim/arc_classic/Kconfig.sysbuild"
osource "/workspaces/zmk/zephyr/soc/snps/hsdk4xd/Kconfig.sysbuild"
osource "/workspaces/zmk/zephyr/soc/snps/hsdk/Kconfig.sysbuild"
osource "/workspaces/zmk/zephyr/soc/snps/emsk/Kconfig.sysbuild"
osource "/workspaces/zmk/zephyr/soc/snps/emsdp/Kconfig.sysbuild"
osource "/workspaces/zmk/zephyr/soc/snps/arc_iot/Kconfig.sysbuild"
osource "/workspaces/zmk/zephyr/soc/silabs/Kconfig.sysbuild"
osource "/workspaces/zmk/zephyr/soc/sifive/sifive_freedom/Kconfig.sysbuild"
osource "/workspaces/zmk/zephyr/soc/sensry/Kconfig.sysbuild"
osource "/workspaces/zmk/zephyr/soc/rockchip/Kconfig.sysbuild"
osource "/workspaces/zmk/zephyr/soc/renode/riscv_virtual/Kconfig.sysbuild"
osource "/workspaces/zmk/zephyr/soc/renode/cortex_r8_virtual/Kconfig.sysbuild"
osource "/workspaces/zmk/zephyr/soc/renesas/smartbond/Kconfig.sysbuild"
osource "/workspaces/zmk/zephyr/soc/renesas/rzt2m/Kconfig.sysbuild"
osource "/workspaces/zmk/zephyr/soc/renesas/rz/Kconfig.sysbuild"
osource "/workspaces/zmk/zephyr/soc/renesas/rcar/Kconfig.sysbuild"
osource "/workspaces/zmk/zephyr/soc/renesas/ra/Kconfig.sysbuild"
osource "/workspaces/zmk/zephyr/soc/realtek/ec/Kconfig.sysbuild"
osource "/workspaces/zmk/zephyr/soc/raspberrypi/rpi_pico/Kconfig.sysbuild"
osource "/workspaces/zmk/zephyr/soc/quicklogic/eos_s3/Kconfig.sysbuild"
osource "/workspaces/zmk/zephyr/soc/qemu/virt_riscv/Kconfig.sysbuild"
osource "/workspaces/zmk/zephyr/soc/qemu/malta/Kconfig.sysbuild"
osource "/workspaces/zmk/zephyr/soc/openisa/rv32m1/Kconfig.sysbuild"
osource "/workspaces/zmk/zephyr/soc/nxp/s32/Kconfig.sysbuild"
osource "/workspaces/zmk/zephyr/soc/nxp/rw/Kconfig.sysbuild"
osource "/workspaces/zmk/zephyr/soc/nxp/mcx/Kconfig.sysbuild"
osource "/workspaces/zmk/zephyr/soc/nxp/lpc/Kconfig.sysbuild"
osource "/workspaces/zmk/zephyr/soc/nxp/layerscape/Kconfig.sysbuild"
osource "/workspaces/zmk/zephyr/soc/nxp/kinetis/Kconfig.sysbuild"
osource "/workspaces/zmk/zephyr/soc/nxp/imxrt/Kconfig.sysbuild"
osource "/workspaces/zmk/zephyr/soc/nxp/imx/Kconfig.sysbuild"
osource "/workspaces/zmk/zephyr/soc/nuvoton/numicro/Kconfig.sysbuild"
osource "/workspaces/zmk/zephyr/soc/nuvoton/numaker/Kconfig.sysbuild"
osource "/workspaces/zmk/zephyr/soc/nuvoton/npcx/Kconfig.sysbuild"
osource "/workspaces/zmk/zephyr/soc/nuvoton/npcm/Kconfig.sysbuild"
osource "/workspaces/zmk/zephyr/soc/nordic/Kconfig.sysbuild"
osource "/workspaces/zmk/zephyr/soc/neorv32/Kconfig.sysbuild"
osource "/workspaces/zmk/zephyr/soc/native/inf_clock/Kconfig.sysbuild"
osource "/workspaces/zmk/zephyr/soc/microchip/miv/Kconfig.sysbuild"
osource "/workspaces/zmk/zephyr/soc/microchip/mec/Kconfig.sysbuild"
osource "/workspaces/zmk/zephyr/soc/mediatek/mt8xxx/Kconfig.sysbuild"
osource "/workspaces/zmk/zephyr/soc/lowrisc/opentitan/Kconfig.sysbuild"
osource "/workspaces/zmk/zephyr/soc/litex/litex_vexriscv/Kconfig.sysbuild"
osource "/workspaces/zmk/zephyr/soc/ite/ec/Kconfig.sysbuild"
osource "/workspaces/zmk/zephyr/soc/intel/raptor_lake/Kconfig.sysbuild"
osource "/workspaces/zmk/zephyr/soc/intel/lakemont/Kconfig.sysbuild"
osource "/workspaces/zmk/zephyr/soc/intel/intel_socfpga_std/Kconfig.sysbuild"
osource "/workspaces/zmk/zephyr/soc/intel/intel_socfpga/Kconfig.sysbuild"
osource "/workspaces/zmk/zephyr/soc/intel/intel_niosv/Kconfig.sysbuild"
osource "/workspaces/zmk/zephyr/soc/intel/intel_ish/Kconfig.sysbuild"
osource "/workspaces/zmk/zephyr/soc/intel/intel_adsp/Kconfig.sysbuild"
osource "/workspaces/zmk/zephyr/soc/intel/elkhart_lake/Kconfig.sysbuild"
osource "/workspaces/zmk/zephyr/soc/intel/atom/Kconfig.sysbuild"
osource "/workspaces/zmk/zephyr/soc/intel/apollo_lake/Kconfig.sysbuild"
osource "/workspaces/zmk/zephyr/soc/intel/alder_lake/Kconfig.sysbuild"
osource "/workspaces/zmk/zephyr/soc/infineon/cat3/Kconfig.sysbuild"
osource "/workspaces/zmk/zephyr/soc/infineon/cat1b/Kconfig.sysbuild"
osource "/workspaces/zmk/zephyr/soc/infineon/cat1a/Kconfig.sysbuild"
osource "/workspaces/zmk/zephyr/soc/gd/gd32/Kconfig.sysbuild"
osource "/workspaces/zmk/zephyr/soc/gaisler/leon3/Kconfig.sysbuild"
osource "/workspaces/zmk/zephyr/soc/gaisler/gr716a/Kconfig.sysbuild"
osource "/workspaces/zmk/zephyr/soc/espressif/Kconfig.sysbuild"
osource "/workspaces/zmk/zephyr/soc/ene/kb1200/Kconfig.sysbuild"
osource "/workspaces/zmk/zephyr/soc/efinix/sapphire/Kconfig.sysbuild"
osource "/workspaces/zmk/zephyr/soc/cdns/xtensa_sample_controller/Kconfig.sysbuild"
osource "/workspaces/zmk/zephyr/soc/cdns/sample_controller32/Kconfig.sysbuild"
osource "/workspaces/zmk/zephyr/soc/cdns/dc233c/Kconfig.sysbuild"
osource "/workspaces/zmk/zephyr/soc/brcm/bcmvk/Kconfig.sysbuild"
osource "/workspaces/zmk/zephyr/soc/brcm/bcm2712/Kconfig.sysbuild"
osource "/workspaces/zmk/zephyr/soc/brcm/bcm2711/Kconfig.sysbuild"
osource "/workspaces/zmk/zephyr/soc/atmel/sam0/Kconfig.sysbuild"
osource "/workspaces/zmk/zephyr/soc/atmel/sam/Kconfig.sysbuild"
osource "/workspaces/zmk/zephyr/soc/aspeed/Kconfig.sysbuild"
osource "/workspaces/zmk/zephyr/soc/arm/Kconfig.sysbuild"
osource "/workspaces/zmk/zephyr/soc/arm/beetle/Kconfig.sysbuild"
osource "/workspaces/zmk/zephyr/soc/antmicro/myra/Kconfig.sysbuild"
osource "/workspaces/zmk/zephyr/soc/andestech/Kconfig.sysbuild"
osource "/workspaces/zmk/zephyr/soc/amd/acp_6_0/Kconfig.sysbuild"
osource "/workspaces/zmk/zephyr/soc/ambiq/Kconfig.sysbuild"
osource "/workspaces/zmk/zephyr/soc/altr/zephyr_nios2f/Kconfig.sysbuild"
osource "/workspaces/zmk/zephyr/soc/altr/qemu_nios2/Kconfig.sysbuild"
osource "/workspaces/zmk/zephyr/soc/adi/max32/Kconfig.sysbuild"
```
