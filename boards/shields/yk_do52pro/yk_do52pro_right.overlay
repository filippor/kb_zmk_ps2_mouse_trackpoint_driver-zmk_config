/*
 * Copyright (c) 2020 Pete Johanson
 *
 * SPDX-License-Identifier: MIT
 */

#include "yk_do52pro.dtsi"

&default_transform0 {
    col-offset = <6>;
};

&kscan0 {
    col-gpios
        = <&pro_micro 6 GPIO_ACTIVE_HIGH>
        , <&pro_micro 5 GPIO_ACTIVE_HIGH>
        , <&pro_micro 4 GPIO_ACTIVE_HIGH>
        , <&pro_micro 2 GPIO_ACTIVE_HIGH>
        , <&pro_micro 0 GPIO_ACTIVE_HIGH>
        , <&pro_micro 1 GPIO_ACTIVE_HIGH>
        ;
};

//#include <input/processors.dtsi>
//#include <dt-bindings/zmk/input_transform.h>
//#include <zephyr/dt-bindings/input/input-event-codes.h>
#include "include/mouse_ps2_right.dtsi"
#include <input/processors/report_rate_limit.dtsi>

&tpoint_split { 
     device = <&mouse_ps2>; 
     input-processors = 
        <&zip_report_rate_limit 16>,
        <&zip_xy_transform (INPUT_TRANSFORM_XY_SWAP | INPUT_TRANSFORM_X_INVERT | INPUT_TRANSFORM_Y_INVERT)>;
};

